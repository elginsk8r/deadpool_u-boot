## board/amlogic/a1_korlan_proto/Kconfig
```kconfig
if TARGET_A1_KORLAN_PROTO

config SYS_SOC
	default "a1"

config SYS_BOARD
	default "a1_korlan_proto"

config SYS_VENDOR
	default "amlogic"

config SYS_CONFIG_NAME
	default "a1_korlan_proto"

config CMD_PLLTEST
	bool "support plltest command"
	default y
	help
	  support plltest command

config DTB_BIND_KERNEL
    bool "load dtb from boot part but not flash rsv"
    default n

endif
```

## board/amlogic/c1_nq_bx/Kconfig
```kconfig
if TARGET_C1_NQ_BX

config SYS_SOC
	default "c1"

config SYS_BOARD
	default "c1_nq_bx"

config SYS_VENDOR
	default "amlogic"

config SYS_CONFIG_NAME
	default "c1_nq_bx"

config DTB_BIND_KERNEL
    bool "load dtb from boot part but not flash rsv"
    default n

endif
```

## board/amlogic/c1_nq_p2/Kconfig
```kconfig
if TARGET_C1_NQ_P2

config SYS_SOC
	default "c1"

config SYS_BOARD
	default "c1_nq_p2"

config SYS_VENDOR
	default "amlogic"

config SYS_CONFIG_NAME
	default "c1_nq_p2"

config DTB_BIND_KERNEL
    bool "load dtb from boot part but not flash rsv"
    default n

endif
```

## board/amlogic/c2_spencer_p1/Kconfig
```kconfig
if TARGET_C2_SPENCER_P1

config SYS_SOC
	default "c2"

config SYS_BOARD
	default "c2_spencer_p1"

config SYS_VENDOR
	default "amlogic"

config SYS_CONFIG_NAME
	default "c2_spencer_p1"

config DTB_BIND_KERNEL
    bool "load dtb from boot part but not flash rsv"
    default n

config CMD_PLLTEST
	bool "support plltest command"
	default y
	help
	  support plltest command

config I2C_REGULATOR
    bool "use i2c regulator to configure vddee"
    default n

endif
```

## board/amlogic/c2_xua4_bx/Kconfig
```kconfig
if TARGET_C2_XUA4_BX

config SYS_SOC
	default "c2"

config SYS_BOARD
	default "c2_xua4_bx"

config SYS_VENDOR
	default "amlogic"

config SYS_CONFIG_NAME
	default "c2_xua4_bx"

config DTB_BIND_KERNEL
    bool "load dtb from boot part but not flash rsv"
    default n

config CMD_PLLTEST
	bool "support plltest command"
	default y
	help
	  support plltest command

config I2C_REGULATOR
    bool "use i2c regulator to configure vddee"
    default n

config DDR_WINDOWING_BOOT
    bool "enable/disable ddr windowing boot"
    default n

config LED_AW2026
    bool "enable/disable AW2026 LED"
    default y

endif
```

## board/amlogic/defconfigs/c1_gq_bx_defconfig
```kconfig
CONFIG_ARM=y
CONFIG_ARCH_MESON=y
CONFIG_SYS_TEXT_BASE=0x00000000
CONFIG_MESON_C1=y
CONFIG_AML_TSENSOR=n
CONFIG_AML_TSENSOR_COOL=n
CONFIG_NEED_BL32=y
CONFIG_C1_GQ_BX=y
CONFIG_DEBUG_UART_BASE=0xfe001c00
CONFIG_DEBUG_UART_CLOCK=24000000
CONFIG_DEBUG_UART=y
CONFIG_OF_BOARD_SETUP=y
CONFIG_BOOTCOMMAND="run storeboot"
CONFIG_BOARD_LATE_INIT=y
# CONFIG_DISPLAY_CPUINFO is not set
# CONFIG_DISPLAY_BOARDINFO is not set
CONFIG_SYS_PROMPT="c1_gq_bx# "
# CONFIG_CMD_BDI is not set
# CONFIG_CMD_IMI is not set
CONFIG_CMD_CLKMSR=n
CONFIG_CMD_GPIO=y
CONFIG_CMD_I2C=n
# CONFIG_CMD_LOADB is not set
# CONFIG_CMD_LOADS is not set
CONFIG_CMD_MMC=y
CONFIG_CMD_MTD=y
CONFIG_CMD_SF=n
CONFIG_CMD_SPI=n
CONFIG_CMD_USB=y
CONFIG_CMD_SARADC=n
CONFIG_CMD_ITEST=y
# CONFIG_CMD_SETEXPR is not set
CONFIG_CMD_CACHE=n
CONFIG_CMD_MTDPARTS=n
CONFIG_AML_STORAGE=y
# CONFIG_CMD_RSVMEM is not set
CONFIG_CMD_WATCHDOG=n
CONFIG_CMD_JTAG=n
CONFIG_AML_PARTITION=y
CONFIG_OF_CONTROL=y
CONFIG_OF_EMBED=y
CONFIG_DEFAULT_DEVICE_TREE="meson-c1-c328x-gq"
# CONFIG_REGMAP is not set
CONFIG_ADC=y
CONFIG_SARADC_MESON=y
CONFIG_CLK=y
CONFIG_CLK_MESON=y
CONFIG_CLK_MESON_C1=y
CONFIG_USB_FUNCTION_FASTBOOT=n
CONFIG_DM_GPIO=y
CONFIG_DM_I2C=y
CONFIG_SYS_I2C_MESON=y
CONFIG_MISC=y
CONFIG_DM_MMC=y
CONFIG_MMC_HS200_SUPPORT=y
CONFIG_MMC_MESON_GX=y
CONFIG_MTD=n
CONFIG_NAND=n
CONFIG_DM_SPI_FLASH=n
CONFIG_PHYLIB=n
CONFIG_PHY_AMLOGIC=n
CONFIG_DM_ETH=n
CONFIG_PHY=y
CONFIG_AML_USB3_PHY=y
CONFIG_AML_USB2_PHY=y
CONFIG_PINCTRL=y
CONFIG_PINCONF=y
CONFIG_PINCTRL_MESON_C1=y
CONFIG_DM_REGULATOR=y
CONFIG_DEBUG_UART_MESON=y
CONFIG_DEBUG_UART_ANNOUNCE=y
CONFIG_DEBUG_UART_SKIP_INIT=y
CONFIG_MESON_SERIAL=y
CONFIG_SPI=n
CONFIG_DM_SPI=n
CONFIG_AML_SPICC=y
CONFIG_AML_SPIFCV2=y
CONFIG_USB=y
CONFIG_DM_USB=y
CONFIG_AML_USB=y
CONFIG_USB_XHCI_HCD=y
CONFIG_USB_XHCI_DWC3=y
CONFIG_USB_GADGET=y
CONFIG_USB_GADGET_VENDOR_NUM=0x1b8e
CONFIG_AML_V2_FACTORY_BURN=n
CONFIG_AML_FACTORY_BURN_LOCAL_UPGRADE=n
CONFIG_WDT=y
CONFIG_WDT_MESON=y
CONFIG_AML_DRIVER=y
CONFIG_AML_MEDIA=y
CONFIG_SECURE_POWER_CONTROL=y
CONFIG_EFUSE=n
CONFIG_SHA1=y
CONFIG_OF_LIBFDT_OVERLAY=y
CONFIG_AML_GPT=y
CONFIG_AML_REMOVE_BOOTLOADER_PARTITION=y
CONFIG_CMD_FACTORY_BOOT=y
CONFIG_CMD_REBOOT=y
CONFIG_AML_RPMB_DISABLE=y
CONFIG_IMG_SECURE_CHECK_SZ=66060288
CONFIG_BOOTLOADER_CONTROL_BLOCK=y
CONFIG_CMD_BOOTCTOL_AVB=y
CONFIG_G_AB_SYSTEM=y
CONFIG_CMD_DDR_TEST=y
CONFIG_LZ4=y
CONFIG_CMD_NET=n
CONFIG_CMD_BOOTD=n
CONFIG_CMD_BOOTI=n
CONFIG_CMD_ELF=n
CONFIG_CMD_GO=n
CONFIG_CMD_BOOTEFI=n
CONFIG_CMD_SOURCE=n
CONFIG_CMD_EXT2=n
CONFIG_CMD_FS_GENERIC=n
CONFIG_CMD_PART=n
CONFIG_CMD_PXE=n
CONFIG_CMD_UNZIP=y
CONFIG_CMD_LZMADEC=n
CONFIG_CMD_XIMG=n
CONFIG_CMD_EDITENV=n
CONFIG_NET=n
CONFIG_GENERATE_SMBIOS_TABLE=n
CONFIG_CMD_MEMORY=n
CONFIG_CMD_BLOCK_CACHE=n
CONFIG_CMD_CONSOLE=n
CONFIG_CMD_EFUSE=n
CONFIG_CMD_FLASH=n
CONFIG_CMD_UUID=n
CONFIG_CMD_PINMUX=n
```

## board/amlogic/defconfigs/c2_bsv3_p1_defconfig
```kconfig
CONFIG_ARM=y
CONFIG_ARCH_MESON=y
CONFIG_SYS_TEXT_BASE=0x00000000
CONFIG_MESON_C2=y
# CONFIG_PXP_EMULATOR is not set
CONFIG_AML_TSENSOR=y
CONFIG_AML_TSENSOR_COOL=y
CONFIG_NEED_BL32=y
CONFIG_C2_BSV3_P1=y
CONFIG_DEBUG_UART_BASE=0xfe001c00
CONFIG_DEBUG_UART_CLOCK=24000000
CONFIG_DEBUG_UART=y
CONFIG_OF_BOARD_SETUP=y
CONFIG_BOOTCOMMAND="run storeboot"
CONFIG_BOARD_LATE_INIT=y
# CONFIG_DISPLAY_CPUINFO is not set
# CONFIG_DISPLAY_BOARDINFO is not set
CONFIG_SYS_PROMPT="c2_bsv3_p1# "
# CONFIG_CMD_BDI is not set
# CONFIG_CMD_IMI is not set
CONFIG_CMD_CLKMSR=y
CONFIG_CMD_GPIO=y
CONFIG_CMD_I2C=y
# CONFIG_CMD_LOADB is not set
# CONFIG_CMD_LOADS is not set
CONFIG_CMD_MMC=y
CONFIG_CMD_MTD=y
CONFIG_AML_STORAGE=y
CONFIG_CMD_SF=y
CONFIG_CMD_USB=y
CONFIG_CMD_SARADC=y
# CONFIG_CMD_ITEST is not set
# CONFIG_CMD_SETEXPR is not set
# CONFIG_CMD_MISC is not set
CONFIG_CMD_MTDPARTS=y
CONFIG_AML_STORAGE=y
CONFIG_CMD_RSVMEM=y
CONFIG_CMD_WATCHDOG=y
CONFIG_CMD_JTAG=y
CONFIG_AML_PARTITION=y
CONFIG_OF_CONTROL=y
CONFIG_OF_EMBED=y
CONFIG_DEFAULT_DEVICE_TREE="meson-c2-c325x-bsv3"
# CONFIG_REGMAP is not set
CONFIG_ADC=y
CONFIG_SARADC_MESON=y
CONFIG_SARADC_MESON_C2=y
CONFIG_CLK=y
CONFIG_CLK_MESON=y
CONFIG_CLK_MESON_C2=y
CONFIG_USB_FUNCTION_FASTBOOT=n
CONFIG_DM_GPIO=y
CONFIG_DM_I2C=y
CONFIG_SYS_I2C_MESON=y
CONFIG_MISC=y
CONFIG_DM_MMC=y
CONFIG_MMC_HS200_SUPPORT=y
CONFIG_MMC_MESON_GX=y
CONFIG_MTD=y
CONFIG_AML_MTDPART=y
CONFIG_NAND=y
CONFIG_DM_SPI_FLASH=y
CONFIG_PHY=y
CONFIG_AML_USB3_PHY=y
CONFIG_AML_USB2_PHY=y
CONFIG_PINCTRL=y
CONFIG_PINCONF=y
CONFIG_PINCTRL_MESON_C2=y
CONFIG_DM_REGULATOR=y
CONFIG_DEBUG_UART_MESON=y
CONFIG_DEBUG_UART_ANNOUNCE=y
CONFIG_DEBUG_UART_SKIP_INIT=y
CONFIG_MESON_SERIAL=y
CONFIG_SPI=y
CONFIG_DM_SPI=y
CONFIG_AML_SPIFCV2=y
CONFIG_USB=y
CONFIG_DM_USB=y
CONFIG_AML_USB=y
CONFIG_USB_XHCI_HCD=y
CONFIG_USB_XHCI_DWC3=y
CONFIG_USB_GADGET=y
CONFIG_USB_GADGET_VENDOR_NUM=0x1b8e
CONFIG_WDT=y
CONFIG_WDT_MESON=y
CONFIG_AML_DRIVER=y
CONFIG_AML_MEDIA=y
CONFIG_EFUSE=y
CONFIG_SHA1=y
CONFIG_SHA256=y
CONFIG_OF_LIBFDT_OVERLAY=n
CONFIG_SECURE_POWER_CONTROL=y
CONFIG_AML_GPT=y
CONFIG_AML_REMOVE_BOOTLOADER_PARTITION=y
CONFIG_IMG_SECURE_CHECK_SZ=66060288
CONFIG_CMD_FACTORY_BOOT=y
CONFIG_CMD_REBOOT=y
CONFIG_AML_RPMB_DISABLE=y
CONFIG_CMD_BOOTCTOL_AVB=y
CONFIG_G_AB_SYSTEM=y
CONFIG_LZ4=y
CONFIG_CMD_UNZIP=y
CONFIG_CMD_GET_CHIPTYPE=y
CONFIG_I2C_REGULATOR=y
CONFIG_AML_GPT_SYNC_ENTIRE_ENTRY=y
CONFIG_SCHUMACHER_SSR=y
# CONFIG_CMD_BOOTD is not set
# CONFIG_CMD_BOOTZ is not set
# CONFIG_CMD_BOOTI is not set
# CONFIG_CMD_MEMORY is not set
# CONFIG_CMD_SOURCE is not set
# CONFIG_CMD_JTAG is not set
```

## board/amlogic/s4_t211/Kconfig
```kconfig
if TARGET_S4_T211

config SYS_SOC
	default "s4"

config SYS_BOARD
	default "s4_t211"

config SYS_VENDOR
	default "amlogic"

config SYS_CONFIG_NAME
	default "s4_t211"

config DTB_BIND_KERNEL
    bool "load dtb from boot part but not flash rsv"
    default y

config CMD_PLLTEST
	bool "support plltest command"
	default n
	help
	  support plltest command

config AML_REBOOT
       bool "reboot cmd"
       default y
       help
         support uboot reboot cmd

config DEBUG_BOARD_VARIANT_PROD
	bool "debug BOARD_VARIANT_PROD"
	default n
	help
	  Make get_board_vairant() always return BOARD_VARIANT_PROD for
	  debugging

endif
```

## cmd/amlogic/Kconfig
```kconfig
menu "Amlogic commands"

config AML_RPMB_DISABLE
	bool "support RPMB set in bootargs"
	default n
	help
	  Support RPMB set in bootargs.

config AML_STORE_WRAPPER
	depends on AML_STORAGE
	bool "wrapper for store"
	default y
	help
	  based on AML_STORAGE
	  read/write don't care bad blocks

config AML_STORE_WRAPPER
	depends on AML_STORAGE
	bool "wrapper for store"
	default y
	help
	  based on AML_STORAGE
	  read/write don't care bad blocks

config AML_IMG_READ
	depends on AML_STORAGE
	bool "image read"
	default y
	help
	  based on AML_STORAGE
	  read image without specify size

config AML_DEFENV
	bool "aml defenv_without"
	default y
	help
	  support reserv env from c array

config BOOTLOADER_CONTROL_BLOCK
	bool "bootloader control block support"
	default n
	help
	  used for recovery and the bootloader to talk to each other

config CMD_BOOTCTOL_AVB
	bool "avb cmd"
	default n
	help
	  support avb related cmds

config CMD_RSVMEM
	bool "rsvmem cmd"
	default y
	help
	  support rsvmem cmd

config CMD_DDR_D2PLL
	bool "d2pll cmd"
	default n
	help
	  support d2pll cmd

config CMD_DDR_TEST
	bool "ddr test cmd"
	default y
	help
	  support ddr_test cmd

config CMD_OS_IDENT
	bool "os_ident"
	default y
	help
	  Ident OS type

config CMD_REBOOT
	bool "CMD_REBOOT"
	depends on MMC_FTS || NAND_FTS
	help
	 CMD_REBOOT support.

config CMD_FACTORY_BOOT
	bool "CMD_FACTORY_BOOT"
	depends on MMC_FTS || NAND_FTS
	help
	 CMD_FACTORY_BOOT support.

config MMC_FTS
	bool "MMC_FTS"
	default y
	help
	 MMC_FTS support.

config NAND_FTS
	bool "NAND_FTS"
	default n
	help
	 NAND_FTS support.

config IMG_SECURE_CHECK_SZ
	int "secure boot size limitation"
	default 0
	help
	  Check if boot image size is larger than
	  the secure boot size limitation

config G_AB_SYSTEM
	bool "support ab boot for bootloader system"
	depends on CMD_BOOTCTOL_AVB
	default n
	help
	  support ab system operation

config CMD_GET_CHIPTYPE
	bool "get chip type in u-boot"
	default y
	help
	  get chip type and save to command line
endmenu
```

## drivers/ssr/Kconfig
```kconfig
#
# Schumacher (Nest PS13216 SSR) device
#

config SCHUMACHER_SSR
	tristate "Schumacher SSR"
	help
	  Select this to enable PS13216 Solid-State Relay (SSR) support. This driver
	  controls the SSR via i2c bus.
```

## drivers/usb/typec/Kconfig
```kconfig
menuconfig TYPEC
	tristate "USB Type-C Support"
	help
	  TypeC support.

if TYPEC

source "drivers/usb/typec/tcpm/Kconfig"

endif # TYPEC
```

## lib/chromecast/Kconfig
```kconfig
menu "Chromecast"

config CHROMECAST
	bool "Libs or modifications for Chromecast"
	default n

if CHROMECAST

config CHROMECAST_PARTITION
	bool "Chromecast partitions"
	default y
	select PARTITIONS
	select EFI_PARTITION

config CHROMECAST_FACTORY
	bool "Support Chromecast factory partition"
	default y
	select PARTITIONS

config CHROMECAST_AB
	bool "Chromecast A/B partition"
	default y

endif

endmenu
```
